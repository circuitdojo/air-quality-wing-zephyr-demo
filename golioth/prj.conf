## CMakeLists.txt
```
#
# Copyright (c) 2021 Circuit Dojo LLC
#

cmake_minimum_required(VERSION 3.13.4)

# Determine the build type
if (NOT BUILD_TYPE)
  set(BUILD_TYPE debug)
endif()

# Print out build type
message(STATUS "Build type: ${BUILD_TYPE} 🚀")

# Overlays
list(INSERT OVERLAY_CONFIG 0 config/golioth.conf)

find_package(Zephyr REQUIRED HINTS $ENV{ZEPHYR_BASE})

project(air-quality-wing-demo)

target_sources(app PRIVATE src/main.c)
```

## prj.conf
```kconfig
# Heap and stacks
CONFIG_INIT_STACKS=y
CONFIG_MAIN_STACK_SIZE=2048
CONFIG_HEAP_MEM_POOL_SIZE=8192
CONFIG_SYSTEM_WORKQUEUE_STACK_SIZE=4096
CONFIG_EVENTFD=y

# GPIO
CONFIG_GPIO=y

# Logging
CONFIG_LOG=y
CONFIG_CONSOLE=y

# Sensors
CONFIG_I2C=y
CONFIG_SENSOR=y
CONFIG_SHTC3=y
CONFIG_SGP40_CD=y
CONFIG_SERIAL=y
CONFIG_UART_ASYNC_API=y
CONFIG_HPMA115S0=y

# AWQ Library
CONFIG_AQW=y
CONFIG_AQW_CODEC=y

# CONFIG_SENSOR_LOG_LEVEL_DBG=y
# CONFIG_AQW_LOG_LEVEL_DBG=y

# Generic networking options
CONFIG_NETWORKING=y
CONFIG_NET_IPV4=y
CONFIG_NET_IPV6=n

# TLS configuration
CONFIG_MBEDTLS_ENABLE_HEAP=y
CONFIG_MBEDTLS_HEAP_SIZE=10240
CONFIG_MBEDTLS_SSL_MAX_CONTENT_LEN=2048

# Date Time library
CONFIG_DATE_TIME=y

# Modem library
CONFIG_NRF_MODEM_LIB=y
CONFIG_NRF_MODEM_LIB_TRACE_ENABLED=n

# Modem information
CONFIG_MODEM_INFO=y

# LIBC malloc size
CONFIG_MINIMAL_LIBC_MALLOC_ARENA_SIZE=256

# Golioth
CONFIG_GOLIOTH=y
CONFIG_GOLIOTH_SYSTEM_CLIENT=y

# Debug
# CONFIG_SENSOR_LOG_LEVEL_DBG=y
# CONFIG_AQW_LOG_LEVEL_DBG=y
```

## boards/circuitdojo_feather_nrf9160_ns.conf
```kconfig
# General config
CONFIG_HEAP_MEM_POOL_SIZE=4096
CONFIG_NEWLIB_LIBC=y

# Networking
CONFIG_NET_NATIVE=n
CONFIG_NET_SOCKETS_OFFLOAD=y

# Increase native TLS socket implementation, so that it is chosen instead of
# offloaded nRF91 sockets
CONFIG_NET_SOCKETS_TLS_PRIORITY=35

# LTE link control
CONFIG_LTE_LINK_CONTROL=y
CONFIG_LTE_AUTO_INIT_AND_CONNECT=y

# Modem library
CONFIG_NRF_MODEM_LIB=y

# Use NCS fork of mbedTLS, as Zephyr built-in mbedTLS integration (CONFIG_MBEDTLS_BUILTIN) is in
# conflict with CONFIG_NRF_SECURITY
CONFIG_MBEDTLS_TLS_LIBRARY=y
CONFIG_MBEDTLS_SSL_PROTO_DTLS=y
CONFIG_MBEDTLS_GCM_C=y
# ... and disable options y-selected by NCS for no good reason
CONFIG_MBEDTLS_KEY_EXCHANGE_DHE_PSK_ENABLED=n
CONFIG_MBEDTLS_KEY_EXCHANGE_DHE_RSA_ENABLED=n
# ... also increase heap size to "high enough to make it work"
CONFIG_MBEDTLS_HEAP_SIZE=49152

# Enable MCUboot bootloader
CONFIG_BOOTLOADER_MCUBOOT=y
```

## boards/circuitdojo_feather_nrf9160ns.conf
```kconfig
# Logging
CONFIG_UART_CONSOLE=y
CONFIG_LOG_MODE_IMMEDIATE=y
CONFIG_LOG_BACKEND_UART=y

# Networking
CONFIG_NET_NATIVE=n
CONFIG_NET_SOCKETS_OFFLOAD=y

# Use Zephyr mbedTLS, as there was no success so far with using offloaded TLS in
# modem library.
CONFIG_NET_SOCKETS_OFFLOAD_TLS=n

# LTE link control
CONFIG_LTE_LINK_CONTROL=y
CONFIG_LTE_AUTO_INIT_AND_CONNECT=n

# Modem library
CONFIG_NRF_MODEM_LIB=y
```

## src/main.c
```c
/**
 * @author Jared Wolff (hello@jaredwolff.com)
 * @copyright Copyright Circuit Dojo LLC 2021
 */

#include <stdio.h>

#include <zephyr/kernel.h>
#include <zephyr/device.h>
#include <zephyr/drivers/sensor.h>
#include <zephyr/devicetree.h>
#include <zephyr/net/coap.h>
#include <zephyr/sys/reboot.h>
#include <zephyr/logging/log.h>
LOG_MODULE_REGISTER(aqw_golioth_demo);

#include <aqw.h>

#include <modem/lte_lc.h>
#include <modem/nrf_modem_lib.h>
#include <nrf_modem_at.h>
#include <modem/modem_info.h>
#include <nrf_modem.h>
#include <date_time.h>

#include <net/golioth/system_client.h>

#include <codec/aqw.h>

/* Used to prevent the app from running before connecting */
K_SEM_DEFINE(lte_connected, 0, 1);

static struct golioth_client *client = GOLIOTH_SYSTEM_CLIENT_GET();

/* Inverval in seconds */
#define STANDARD_SENSOR_INTERVAL 600

static struct aqw_sensor temperature_sensor =
    {
        .type = AQW_TEMPERATURE_SENSOR,
        .chan = SENSOR_CHAN_AMBIENT_TEMP,
        .dev = DEVICE_DT_GET_ONE(sensirion_shtc3cd),
        .interval = STANDARD_SENSOR_INTERVAL,
};

static struct aqw_sensor humidity_sensor =
    {
        .type = AQW_HUMIDITY_SENSOR,
        .chan = SENSOR_CHAN_HUMIDITY,
        .dev = DEVICE_DT_GET_ONE(sensirion_shtc3cd),
        .interval = STANDARD_SENSOR_INTERVAL,
};

static struct aqw_sensor voc_sensor =
    {
        .type = AQW_VOC_SENSOR,
        .chan = SENSOR_CHAN_VOC,
        .dev = DEVICE_DT_GET_ONE(sensirion_sgp40cd),
        .interval = STANDARD_SENSOR_INTERVAL,
};

static struct aqw_sensor hpma_sensor =
    {
        .type = AQW_PM25_SENSOR,
        .chan = SENSOR_CHAN_PM_2_5,
        .dev = DEVICE_DT_GET_ONE(honeywell_hpma115s0),
        .interval = STANDARD_SENSOR_INTERVAL,
};

static struct aqw_sensor *sensors[] = {
    &temperature_sensor,
    &humidity_sensor,
    &voc_sensor,
    &hpma_sensor,
};

void sensor_cb(struct aqw_sensor_data *data, size_t len)
{
    int err = 0;
    uint8_t buf[256];
    size_t size = 0;

    for (int i = 0; i < len; i++)
    {

        /* Skip if not valid */
        if (data[i].type == AQW_INVALID_SENSOR)
            continue;

        LOG_INF("%s: %i.%i%s", aqw_sensor_type_to_string(data[i].type), data[i].val.val1, data[i].val.val2, aqw_sensor_unit_to_string(data[i].type));

        /* Get the current time */
        err = date_time_now(&data[i].ts);
        if (err)
        {
            LOG_WRN("Unable to get timestamp!");
        }
    }

    struct app_codec_payload payload = {
        .data = data,
        .sensor_count = len,
    };

    /* Encode CBOR data */
    err = app_codec_aqw_data_encode(&payload, buf, sizeof(buf), &size);
    if (err < 0)
    {
        LOG_ERR("Unable to encode data. Err: %i", err);
        return;
    }

    LOG_INF("Data size: %i", size);

    /* Publish gps data */
    err = golioth_lightdb_set(client,
                              "env",
                              COAP_CONTENT_FORMAT_APP_CBOR,
                              buf, size);
    if (err)
    {
        LOG_WRN("Failed to send data: %d", err);
    }
}

static void lte_handler(const struct lte_lc_evt *const evt)
{
    switch (evt->type)
    {
    case LTE_LC_EVT_NW_REG_STATUS:
        if ((evt->nw_reg_status != LTE_LC_NW_REG_REGISTERED_HOME) &&
            (evt->nw_reg_status != LTE_LC_NW_REG_REGISTERED_ROAMING))
        {
            /*  TODO: Send disconnected event */

            break;
        }

        /* TODO: Otherwise send connected event */

        LOG_INF("Network registration status: %s",
                evt->nw_reg_status == LTE_LC_NW_REG_REGISTERED_HOME ? "Connected - home network" : "Connected - roaming");

        k_sem_give(&lte_connected);
        break;
    case LTE_LC_EVT_PSM_UPDATE:
        LOG_INF("PSM parameter update: TAU: %d, Active time: %d",
                evt->psm_cfg.tau, evt->psm_cfg.active_time);
        break;
    case LTE_LC_EVT_EDRX_UPDATE:
    {
        char log_buf[60];
        ssize_t len;

        len = snprintf(log_buf, sizeof(log_buf),
                       "eDRX parameter update: eDRX: %f, PTW: %f",
                       evt->edrx_cfg.edrx, evt->edrx_cfg.ptw);
        if (len > 0)
        {
            LOG_INF("%s", log_buf);
        }
        break;
    }
    case LTE_LC_EVT_RRC_UPDATE:
        LOG_INF("RRC mode: %s",
                evt->rrc_mode == LTE_LC_RRC_MODE_CONNECTED ? "Connected" : "Idle");
        break;
    case LTE_LC_EVT_CELL_UPDATE:
        LOG_INF("LTE cell changed: Cell ID: %d, Tracking area: %d",
                evt->cell.id, evt->cell.tac);
        break;
    default:
        break;
    }
}

static void nrf_modem_lib_dfu_handler(void)
{
    int err;

    err = nrf_modem_lib_init(NORMAL_MODE);

    switch (err)
    {
    case NRF_MODEM_DFU_RESULT_OK:
        LOG_INF("Modem update suceeded, reboot");
        sys_reboot(SYS_REBOOT_COLD);
        break;
    case NRF_MODEM_DFU_RESULT_UUID_ERROR:
    case NRF_MODEM_DFU_RESULT_AUTH_ERROR:
        LOG_ERR("Modem update failed, error: %d", err);
        LOG_ERR("Modem will use old firmware");
        sys_reboot(SYS_REBOOT_COLD);
        break;
    case NRF_MODEM_DFU_RESULT_HARDWARE_ERROR:
    case NRF_MODEM_DFU_RESULT_INTERNAL_ERROR:
        LOG_ERR("Modem update malfunction, error: %d, reboot", err);
        sys_reboot(SYS_REBOOT_COLD);
        break;
    default:
        break;
    }
}

void date_time_evt(const struct date_time_evt *evt)
{

    /*Setup and connect to Golioth once we have the time*/
    golioth_system_client_start();
}

static int modem_init()
{

    int err = 0;

    nrf_modem_lib_dfu_handler();

    if (IS_ENABLED(CONFIG_LTE_AUTO_INIT_AND_CONNECT))
    {
        /* Do nothing, modem is already configured and LTE connected. */
    }
    else
    {
        LOG_INF("Connecting..");

        err = lte_lc_init_and_connect_async(lte_handler);
        if (err)
        {
            LOG_ERR("Modem could not be configured, error: %d",
                    err);
            return err;
        }
    }

    err = modem_info_init();
    if (err)
    {
        LOG_ERR("Failed initializing modem info module, error: %d",
                err);
        return err;
    }

    k_sem_take(&lte_connected, K_FOREVER);

    /* Force time update */
    err = date_time_update_async(date_time_evt);
    if (err)
    {
        LOG_ERR("Unable to update time with date_time_update_async. Err: %i", err);
    }

    return 0;
}

void main(void)
{
    int err = 0;

    /* Init modem first */
    err = modem_init();
    if (err)
        __ASSERT_MSG_INFO("Error initializing Golioth. Err: %i", err);

    LOG_INF("Air Quality Wing Golioth Demo");

    /* Init Air Quality Wing */
    err = aqw_init(sensors, ARRAY_SIZE(sensors), sensor_cb);
    if (err)
        __ASSERT_MSG_INFO("Unable to init Air Quality Wing library. Err: %i", err);

    err = aqw_sensor_start_fetch();
    if (err)
        __ASSERT_MSG_INFO("Unable to start fetch. Err: %i", err);
}
```
